## conf/distro/include/philips-ocean-preferred-env.inc
```bitbake
include conf/distro/include/fsl-imx-preferred-env.inc

DISTRO_NAME = "Philips OCEAN Release Distro"
DISTRO_VERSION = "0.2.1.0"
DISTROOVERRIDES = "ocean"

# define the virtual/bootloader is u-boot-ocean
PREFERRED_PROVIDER_virtual/bootloader:imx-nxp-bsp = "u-boot-ocean"

# define the virtual/kernel is linux-ocean
PREFERRED_PROVIDER_linux-imx-mfgtool:remove = "linux-imx-mfgtool"
PREFERRED_PROVIDER_virtual/kernel:imx-nxp-bsp = "linux-ocean"
```

## conf/distro/philips-ocean-wayland.conf
```bitbake
# Philips OCEAN DISTRO for Wayland without X11

include conf/distro/include/fsl-imx-base.inc
include conf/distro/include/philips-ocean-preferred-env.inc

DISTRO = "philips-ocean-wayland"

# Remove conflicting backends
DISTRO_FEATURES:remove = "directfb x11 "
DISTRO_FEATURES:append = " wayland pam systemd"
```

## conf/distro/philips-ocean-xwayland.conf
```bitbake
# Philips OCEAN DISTRO for Wayland with X11

include conf/distro/include/fsl-imx-base.inc
include conf/distro/include/philips-ocean-preferred-env.inc

DISTRO = "philips-ocean-xwayland"

# Remove conflicting backends
DISTRO_FEATURES:remove = "directfb "
DISTRO_FEATURES:append = " x11 wayland pam"
```

## conf/layer.conf
```bitbake
# We have a conf and classes directory, add to BBPATH
BBPATH .= ":${LAYERDIR}"

# We have recipes-* directories, add to BBFILES
BBFILES += "${LAYERDIR}/recipes-*/*/*.bb \
            ${LAYERDIR}/recipes-*/*/*.bbappend"

BBFILE_COLLECTIONS += "philips-ocean"
BBFILE_PATTERN_philips-ocean = "^${LAYERDIR}/"
BBFILE_PRIORITY_philips-ocean = "6"

LAYERDEPENDS_philips-ocean = "freescale-layer"
LAYERSERIES_COMPAT_philips-ocean = "mickledore"


# Overrides for imx8mp-lpddr4-ocean
#MACHINE_FEATURES_IMX_REMOVALS:append:imx8mp-lpddr4-ocean = " jailhouse"
MACHINE_FEATURES:append:imx8mp-lpddr4-ocean = " optee dpdk"
KERNEL_DEVICETREE:append:imx8mp-lpddr4-ocean = " \
    freescale/imx8mp-ocean.dtb \
"

# FIXME: Drop these lines when the external layers are marked compatible
LAYERSERIES_COMPAT_chromium-browser-layer:append = " langdale mickledore"
LAYERSERIES_COMPAT_imx-demo:append = " mickledore"

# Define new EULAs and add them to the list defined in meta-freescale.
# See fsl-eula-unpack.bbclass.
FSL_EULA_FILE_MD5SUM_LA_OPT_NXP_SOFTWARE_LICENSE_V44 = "d7853b7bf2936b2c25c893eac7033374"
FSL_EULA_FILE_MD5SUM_LA_OPT_NXP_SOFTWARE_LICENSE_V45 = "63a38e9f392d8813d6f1f4d0d6fbe657"
FSL_EULA_FILE_MD5SUM_LA_OPT_NXP_SOFTWARE_LICENSE_V46 = "673fa34349fa40f59e0713cb0ac22b1f"
FSL_EULA_FILE_MD5SUM_LA_OPT_NXP_SOFTWARE_LICENSE_V47 = "9135422c7a38dac21bf1f858b6ef3bac"
FSL_EULA_FILE_MD5SUM_LA_OPT_NXP_SOFTWARE_LICENSE_V48 = "db4762b09b6bda63da103963e6e081de"

FSL_EULA_FILE_MD5SUMS:append = " \
    ${FSL_EULA_FILE_MD5SUM_LA_OPT_NXP_SOFTWARE_LICENSE_V44} \
    ${FSL_EULA_FILE_MD5SUM_LA_OPT_NXP_SOFTWARE_LICENSE_V45} \
    ${FSL_EULA_FILE_MD5SUM_LA_OPT_NXP_SOFTWARE_LICENSE_V46} \
    ${FSL_EULA_FILE_MD5SUM_LA_OPT_NXP_SOFTWARE_LICENSE_V47} \
    ${FSL_EULA_FILE_MD5SUM_LA_OPT_NXP_SOFTWARE_LICENSE_V48} \
"

###remote bt wifi pci to avoid conflict with meta-summit-radio layer's driver
DISTRO_FEATURES:remove = "wifi pci "
MACHINE_FEATURES:remove = "bluetooth wifi pci nxp8997-pcie nxp8997-sdio nxp9098-sdio nxp8801-sdio nxp8987-sdio nxp8997-pcie nxp8997-sdio nxp9098-sdio nxp9098-pcie nxp9098-pcie nxpiw416-sdio nxpiw612-sdio"
```

## conf/machine/imx8mp-lpddr4-ocean.conf
```bitbake
#@TYPE: Machine
#@NAME: Philips OCEAN
#@SOC: i.MX8MP
#@DESCRIPTION: Machine configuration for Philips OCEAN Evaluation Kit

require include/imx8mp-ocean.inc

# Ocean u-boot and kernel  device tree
UBOOT_DTB_NAME:${MACHINE} = "imx8mp-ocean.dtb"
KERNEL_DEVICETREE:${MACHINE} = " \
    freescale/imx8mp-ocean.dtb \
    freescale/imx8mp-ocean-pacific.dtb \
    freescale/imx8mp-ocean-atlantic-lcd10.dtb \
    freescale/imx8mp-ocean-atlantic-lcd12.dtb \
    freescale/imx8mp-ocean-atlantic-lcd15.dtb \
"

UBOOT_CONFIG_BASENAME = "imx8mp_ocean"
UBOOT_CONFIG[fspi] = "${UBOOT_CONFIG_BASENAME}_defconfig"
UBOOT_CONFIG[ndm]  = "${UBOOT_CONFIG_BASENAME}_ndm_defconfig"

# Set DDR FIRMWARE
DDR_FIRMWARE_VERSION = "202006"
DDR_FIRMWARE_NAME = " \
    lpddr4_pmu_train_1d_dmem_${DDR_FIRMWARE_VERSION}.bin \
    lpddr4_pmu_train_1d_imem_${DDR_FIRMWARE_VERSION}.bin \
    lpddr4_pmu_train_2d_dmem_${DDR_FIRMWARE_VERSION}.bin \
    lpddr4_pmu_train_2d_imem_${DDR_FIRMWARE_VERSION}.bin \
"

IMXBOOT_TARGETS_BASENAME = "flash_evk"

# Mainline BSP doesn't support LPDDR4 so it must be set to nxp.
# Also this machine isn't supported by u-boot-fslc but imx8mn-evk.inc already
# set the bootloader to u-boot-imx instead when NXP BSP is used.
IMX_DEFAULT_BSP = "nxp"

# For Ocean costumized partition definition
WKS_FILE="ocean-boot-bootpart.wks.in"
# for bootloader (align 32K,total 8M), align unit is KiB, size unit is MiB
OCEAN_BOOT_ALIGN = "32"
OCEAN_BOOT_SIZE = "8"
# for kernel  (align 128K, size 128M) and root (align 4M, size 4G)
OCEAN_KERNEL_LABEL = "boot"
OCEAN_KERNEL_ALIGN = "128"
OCEAN_KERNEL_SIZE = "128"
OCEAN_ROOTFS_LABEL = "root"
OCEAN_ROOTFS_ALIGN = "128"
OCEAN_ROOTFS_SIZE = "4096"
# for kernel backup (align 128K, size 128K) 
OCEAN_KERNEL_LABEL_RED = "boot_red"
OCEAN_KERNEL_ALIGN_RED = "${OCEAN_KERNEL_ALIGN}"
OCEAN_KERNEL_SIZE_RED = "${OCEAN_KERNEL_SIZE}"
# for root backup (align 4M, size 4G) 
OCEAN_ROOTFS_LABEL_RED = "root_red"
OCEAN_ROOTFS_ALIGN_RED =  "${OCEAN_ROOTFS_ALIGN}"
OCEAN_ROOTFS_SIZE_RED = "${OCEAN_ROOTFS_SIZE}"
# for permernant data (align 4M, size 2G) 
OCEAN_ROOTFS_LABEL_DATA = "data"
OCEAN_ROOTFS_ALIGN_DATA =  "${OCEAN_ROOTFS_ALIGN}"
OCEAN_ROOTFS_SIZE_DATA = "${OCEAN_ROOTFS_SIZE}"
```
